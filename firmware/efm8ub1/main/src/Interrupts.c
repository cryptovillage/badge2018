//=========================================================
// src/Interrupts.c: generated by Hardware Configurator
//
// This file will be regenerated when saving a document.
// leave the sections inside the "$[...]" comment tags alone
// or they will be overwritten!
//=========================================================

// USER INCLUDES
#include <SI_EFM8UB1_Register_Enums.h>
#include "board.h"

#include "efm8_usb.h"
#include "descriptors.h"
#include "usb_0.h"

//-----------------------------------------------------------------------------
// VBUS_ISR
//-----------------------------------------------------------------------------
//
// VBUS ISR Content goes here. Remember to clear flag bits:
// USB0CDSTA::DCDI (Data Contact Detect Complete)
// USB0CDSTA::ERR (USB Charger Detection Error)
// USB0CDSTA::PDI (Primary Detection Complete)
// USB0CDSTA::SDI (Secondary Detection Complete)
// USB0CF::VBUSI (VBUS Interrupt)
//
//-----------------------------------------------------------------------------
SI_INTERRUPT (VBUS_ISR, VBUS_IRQn)
{
	SFRPAGE = USB0_PAGE;

	if (USB0CF & USB0CF_VBUSI__SET) {
		USB0CF &= ~USB0CF_VBUSI__SET;
	}

	if (USB0CDSTA & USB0CDSTA_DCDI__SET) {
		USB0CDSTA &= ~USB0CDSTA_DCDI__SET;
	}

	if (USB0CDSTA & USB0CDSTA_ERR__ERROR) {
		USB0CDSTA &= ~USB0CDSTA_ERR__ERROR;
	}

	if (USB0CDSTA & USB0CDSTA_PDI__SET) {
		if (USB0CDSTA & USB0CDSTA_SDP__DETECTED) {
			powerFlags |= POWER_FLAG_USB_HOST_CONNECTED |
					POWER_FLAG_POWER_FLAGS_CHANGED;
			USB0CDCN = 0;
			USBD_Init (&initstruct);
		}
		USB0CDSTA &= ~USB0CDSTA_PDI__SET;
	}

	if (USB0CDSTA & USB0CDSTA_SDI__SET) {
		if (USB0CDSTA & (USB0CDSTA_CDP__DETECTED)) {
			powerFlags |= POWER_FLAG_USB_CDP_CONNECTED |
					POWER_FLAG_POWER_FLAGS_CHANGED;
		}
		if (USB0CDSTA & (USB0CDSTA_DCP__DETECTED)) {
			powerFlags |= POWER_FLAG_USB_DCP_CONNECTED |
					POWER_FLAG_POWER_FLAGS_CHANGED;
		}
		USB0CDCN = 0;
		USBD_Init (&initstruct);
		USB0CDSTA &= ~USB0CDSTA_SDI__SET;
	}
}
